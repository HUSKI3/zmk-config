/ {
    chosen {
        zmk,underglow = &underglow;
    };
};

&spi3 {
    status = "okay";

    underglow: ws2812@0 {
        compatible = "worldsemi,ws2812-spi";

        spi-max-frequency = <4000000>;
        chain-length = <10>;
        color-mapping = <1 0 2>;
    };
};